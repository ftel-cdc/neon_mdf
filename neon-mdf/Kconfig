## neon-mdf/components/driver/Kconfig
```kconfig
menu "components/driver"

config NEON_MDF_DRIVER_UART
    bool "Compile UART drivers"
    default y
    help
        HAL UART polling, FIFO and interrupt-control notifications in build. FU2: Enable UART while
        compiling printf/vprintf/puts/putchar and syscall hook _write, no separate printf flag is
        required. The console initializes UART0 on the first export. Disabling option will remove
        the UART driver and FU2 console from the build; calling those APIs will report link errors.

config NEON_MDF_DRIVER_I2C
    bool "Compile I2C driver (i2c/neon_i2c_fu2.c)"
    default y
    help
        HAL I2C FU2: master/slave polling and interrupt, address 7/10
        bit, memory-read repeated START, FIFO, SMBus/PEC, DMA request,
        bus-clear, CRM management and self-configuration SDA/SCL. Timing using period number i2c_clk; board
        must have external pull-up resistors on both SDA and SCL.

config NEON_MDF_DRIVER_CRC
    bool "Compile CRC-8 driver (crc/neon_crc_fu2.c)"
    default y
    help
        Includes CRC-8 driver (NEON_CRC_Calculate) - real port from src_fu2/fu2_crc.c. Disabled to reduce
        Flash usage if the app is not in use.

config NEON_MDF_DRIVER_EFUSE
    bool
    default n
    help
        Old sdkconfig compatible symbol; OTP source kept at driver/efuse. FU2 ROM v5 save security policy
        and public key in Flash NVR; use Flash driver's NVR API, not old OTP address.

config NEON_MDF_DRIVER_ADC
    bool "Compile ADC driver (adc/neon_adc_fu2.c)"
    default y
    help
        FU2 ADC: 12-bit sample slots, configuration channel/timing and polling.

config NEON_MDF_DRIVER_DMA
    bool "Compile DMA driver (dma/neon_dma_fu2.c)"
    default y
    help
        FU2 FTEL DMA: 8 channel, command register and 32-bit copy word.

config NEON_MDF_DRIVER_SPI
    bool "Compile SPI driver (spi/neon_spi_fu2.c)"
    default y
    help
        HAL SPI master/slave: polling 8/16/24/32-bit, full-duplex, slave-select, timing, FIFO,
        interrupt-status, clock-failure and DMA communication configuration. Pinmux that board
        configuration before transmission.

config NEON_MDF_DRIVER_PWM
    bool "Compile PWM driver (pwm/neon_pwm_fu2.c)"
    default y
    help
        Report includes two-channel PWM FU2 v8 DTI drivers (NEON_PWM_Init/Start/Stop/SetPeriod/SetPulse),
        following the PWM DTI register map selected by FU2 v8 VP.

config NEON_MDF_DRIVER_TIM
    bool "Compile the TIM driver (tim/neon_tim_fu2.c)"
    default y
    help
        report including full Timer driver for two channels CH0/CH1: configuration counter,
        prescaler/reload, compare, update/preload/one-pulse/center-aligned,
        interrupt/flag and clock-failure status. Bitfield and background logic taken from FU2 LL; public API
        checks parameters and returns NEON_StatusTypeDef.

config NEON_MDF_DRIVER_RTC
    bool "Compile RTC driver (rtc/neon_rtc_fu2.c)"
    default y
    help
        Report includes RTC driver (NEON_RTC_Init/SetTime/GetTime/SetDate/GetDate) - Init/DeInit port real
        from src_fu2/fu2_dti_rtc.c, Set/GetTime/Date write new pairing inline helper BCD real in
        header.

config NEON_MDF_DRIVER_TRNG
    bool "Compile TRNG driver (trng/neon_trng_fu2.c)"
    default y
    help
        Report included driver TRNG (NEON_TRNG_Init/GetRandomNumber) - Init/DeInit port real from
        src_fu2/fu2_dti_trng.c, GetRandomNumber write new pairing inline helper real in header. 3rd
        IP (Dolphin Technology).

config NEON_MDF_DRIVER_AES
    bool "Compile AES driver (aes/neon_aes_fu2.c)"
    default y
    help
        FU2 AES-128: ECB/CBC/CTR, key/IV and polling READY/DONE.

config NEON_MDF_DRIVER_QSPI
    bool "Compile QSPI driver (qspi/neon_qspi_fu2.c)"
    default y
    help
        QSPI driver included Indirect mode (NEON_QSPI_Init/SendCommand/ WriteData/ReadData) -
        Init/DeInit/SendCommand real port from src_fu2/fu2_dti_qspi.c. Only control via APB window,
        not memory-mapped mode (XiP).

config NEON_MDF_DRIVER_WDT
    bool "Compile watchdog driver (wdt/neon_wdt_fu2.c)"
    default y
    help
        FU2 watchdog: timeout range, reset/interrupt response, refresh,
        read counter and acknowledge interrupt.

config NEON_MDF_DRIVER_ETH
    bool "Compile Ethernet driver (FX1)"
    default y
    help
        FTEL Ethernet MAC: descriptor DMA, Clause 22 MDIO, polling/IRQ
        service and bounded stop/recovery. Currently implemented for FX1.
        No TCP/IP stack or host network interface is included.

config NEON_MDF_DRIVER_MIPI
    bool "Compile FX1 MIPI D-PHY driver"
    default n
    help
        FX1-only D-PHY ownership, lane and recovery driver. It is reusable by
        CSI-2 camera input and a future DSI display client.

config NEON_MDF_DRIVER_CSI
    bool "Compile FX1 CSI-2 receiver driver"
    default n
    select NEON_MDF_DRIVER_MIPI
    help
        FX1 CSI-2 receiver driver: virtual channel, RAW format and ingress
        lifecycle. Camera runtime is a client, not the owner of this driver.

config NEON_MDF_DRIVER_ISP
    bool "Compile FX1 ISP HAL"
    default n
    help
        FX1 ISP HAL: RAW in, NV12 out, both through DMA buffers in DDR, plus global AE/AWB/AF
        statistics. AE/AWB/AF policy is deliberately outside this driver, in neon_camera_runtime.

config NEON_MDF_CAMERA_SIMULATION
    bool "Use the in-RAM simulation backends of MIPI, CSI and ISP"
    depends on NEON_MDF_DRIVER_MIPI || NEON_MDF_DRIVER_CSI || NEON_MDF_DRIVER_ISP
    default y
    help
        Selects the in-RAM backends of the MIPI D-PHY, CSI-2 and ISP HAL. They follow the MAS behaviour
        (Stop State bring-up, ping-pong DMA, buffer ownership, error policies, rotating ISP DMA) but touch
        no register. The FX1 register backends are not written yet: they need the register workbook (MIPI,
        CSI) or the rotating DMA on top of ftel_isp (ISP). Turning this off stops the build with a message
        until then.

endmenu
```

## neon-mdf/components/ftel_isp/Kconfig
```kconfig
config NEON_MDF_FTEL_ISP
    bool "Build FX1 ISP v1.07 component (FX1 platform only)"
    default n

config NEON_MDF_FTEL_ISP_3A
    bool "Link binary 3A package for FX1"
    depends on NEON_MDF_FTEL_ISP
    default n
    help
        Build the OS-independent stats/controls adapter and link the FX1
        libisp_3a.a distribution. The application provides both camera bins.
```

## neon-mdf/components/neon_camera_runtime/Kconfig
```kconfig
config NEON_MDF_CAMERA_RUNTIME
    bool "Build Neon camera runtime"
    default n
    select NEON_MDF_DRIVER_MIPI
    select NEON_MDF_DRIVER_CSI
    select NEON_MDF_DRIVER_ISP
    help
        Owns one camera pipeline, camera profiles, sensor HAL binding and 3A.
        Hardware access remains in the reusable driver components.

if NEON_MDF_CAMERA_RUNTIME

choice NEON_MDF_CAMERA_SENSOR
    prompt "Reference sensor module"
    default NEON_MDF_CAMERA_SENSOR_IMX675

config NEON_MDF_CAMERA_SENSOR_IMX675
    bool "IMX675"

config NEON_MDF_CAMERA_SENSOR_OS04C10
    bool "OS04C10"

endchoice

endif
```
